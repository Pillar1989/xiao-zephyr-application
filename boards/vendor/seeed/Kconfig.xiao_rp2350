## boards/vendor/seeed/board.yml
```yaml
# Copyright (c) 2024 Nordic Semiconductor ASA
# SPDX-License-Identifier: Apache-2.0

board:
  name: xiao_rp2350
  full_name: Seeed Xiao RP2350
  vendor: seeed
  socs:
    - name: rp2350a
```
